#include "slicemk_ergodox.dtsi"

&default_transform {
	col-offset = <8>;
};

/ {
	kscan0: kscan {
		compatible = "zmk,kscan-gpio-matrix";
		label = "KSCAN";
		diode-direction = "row2col";

		col-gpios
			= <&ergodox_a 6 (GPIO_ACTIVE_HIGH | GPIO_PULL_DOWN)>
			, <&ergodox_a 5 (GPIO_ACTIVE_HIGH | GPIO_PULL_DOWN)>
			, <&ergodox_a 4 (GPIO_ACTIVE_HIGH | GPIO_PULL_DOWN)>
			, <&ergodox_a 3 (GPIO_ACTIVE_HIGH | GPIO_PULL_DOWN)>
			, <&ergodox_a 2 (GPIO_ACTIVE_HIGH | GPIO_PULL_DOWN)>
			, <&ergodox_a 1 (GPIO_ACTIVE_HIGH | GPIO_PULL_DOWN)>
			, <&ergodox_a 0 (GPIO_ACTIVE_HIGH | GPIO_PULL_DOWN)>
			;
		row-gpios
			= <&ergodox_a  7 GPIO_ACTIVE_HIGH>
			, <&ergodox_a  8 GPIO_ACTIVE_HIGH>
			, <&ergodox_a  9 GPIO_ACTIVE_HIGH>
			, <&ergodox_a 10 GPIO_ACTIVE_HIGH>
			, <&ergodox_a 11 GPIO_ACTIVE_HIGH>
			, <&ergodox_a 12 GPIO_ACTIVE_HIGH>
			;
	};
};
