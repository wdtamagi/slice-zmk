## app/boards/arm/nordic_nrf52840_dongle_debug/Kconfig.board
```kconfig
config BOARD_NORDIC_NRF52840_DONGLE_DEBUG
	bool "Nordic nRF52840 Dongle Debug"
	depends on SOC_NRF52840_QIAA
```

## app/boards/arm/nordic_nrf52840_dongle_debug/Kconfig.defconfig
```kconfig
if BOARD_NORDIC_NRF52840_DONGLE_DEBUG

config BOARD
	default "Nordic nRF52840 Dongle Debug"

if USB

config USB_NRFX
	default y

config USB_DEVICE_STACK
	default y

endif # USB

config BT_CTLR
	default BT

endif # BOARD_NORDIC_NRF52840_DONGLE_DEBUG
```

## app/boards/arm/nordic_nrf52840_dongle_official/Kconfig.board
```kconfig
config BOARD_NORDIC_NRF52840_DONGLE_OFFICIAL
	bool "Nordic nRF52840 Dongle Official"
	depends on SOC_NRF52840_QIAA
```

## app/boards/arm/nordic_nrf52840_dongle_official/Kconfig.defconfig
```kconfig
if BOARD_NORDIC_NRF52840_DONGLE_OFFICIAL

config BOARD
	default "Nordic nRF52840 Dongle Official"

if USB

config USB_NRFX
	default y

config USB_DEVICE_STACK
	default y

endif # USB

config BT_CTLR
	default BT

endif # BOARD_NORDIC_NRF52840_DONGLE_OFFICIAL
```

## app/boards/shields/dactyl/Kconfig.defconfig
```kconfig
config ZMK_BLE
	default y

config ZMK_USB
	default y

if SHIELD_DACTYL_DONGLE

config ZMK_KEYBOARD_NAME
	default "Dactyl"

endif

if SHIELD_DACTYL_LEFTCENTRAL || SHIELD_DACTYL_LEFTSINGLE

config ZMK_KEYBOARD_NAME
	default "Dactyl Left"

endif

if SHIELD_DACTYL_RIGHTCENTRAL || SHIELD_DACTYL_RIGHTSINGLE

config ZMK_KEYBOARD_NAME
	default "Dactyl Right"

endif

if SHIELD_DACTYL_DONGLE || SHIELD_DACTYL_LEFTCENTRAL || SHIELD_DACTYL_RIGHTCENTRAL

config ZMK_SPLIT
	default y

config ZMK_SPLIT_BLE_ROLE_CENTRAL
	default y

endif

if !SHIELD_DACTYL_DONGLE

config ZMK_BATTERY_VOLTAGE_DIVIDER
	default y

endif
```

## app/boards/shields/dactyl/Kconfig.shield
```kconfig
config SHIELD_DACTYL_DONGLE
	def_bool $(shields_list_contains,dactyl_dongle)

config SHIELD_DACTYL_LEFTCENTRAL
	def_bool $(shields_list_contains,dactyl_leftcentral)

config SHIELD_DACTYL_RIGHTCENTRAL
	def_bool $(shields_list_contains,dactyl_rightcentral)

config SHIELD_DACTYL_LEFTSINGLE
	def_bool $(shields_list_contains,dactyl_leftsingle)

config SHIELD_DACTYL_RIGHTSINGLE
	def_bool $(shields_list_contains,dactyl_rightsingle)
```

## app/boards/shields/slicemk_ergodox/Kconfig.defconfig
```kconfig
config ZMK_BLE
	default y

config ZMK_USB
	default y

if SHIELD_SLICEMK_ERGODOX_DONGLE

config ZMK_KEYBOARD_NAME
	default "SliceMK ErgoDox"

endif

if SHIELD_SLICEMK_ERGODOX_LEFTCENTRAL || SHIELD_SLICEMK_ERGODOX_LEFTSINGLE

config ZMK_KEYBOARD_NAME
	default "ErgoDox Left"

endif

if SHIELD_SLICEMK_ERGODOX_RIGHTCENTRAL || SHIELD_SLICEMK_ERGODOX_RIGHTSINGLE

config ZMK_KEYBOARD_NAME
	default "ErgoDox Right"

endif

if SHIELD_SLICEMK_ERGODOX_DONGLE || SHIELD_SLICEMK_ERGODOX_LEFTCENTRAL || SHIELD_SLICEMK_ERGODOX_RIGHTCENTRAL

config ZMK_SPLIT
	default y

config ZMK_SPLIT_BLE_ROLE_CENTRAL
	default y

endif

if !SHIELD_SLICEMK_ERGODOX_DONGLE

config ZMK_BATTERY_VOLTAGE_DIVIDER
	default y

endif
```
